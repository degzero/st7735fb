/*
 * Device Tree overlay for Adafruit/Waveshare 1.8" TFT LCD with ST7735 chip 160x128
 *
 * compile:
 * dtc -@ -I dts -Odtc -@ -I dts -O dtb -o /boot/overlays/prajst77.dtbo prajst77.dts
 */

/dts-v1/;
/plugin/;

/ {
	compatible = "brcm,bcm2835";

	fragment@0 {
		target = <&spidev0>;
		__overlay__ {
			status = "disabled";
		};
	};

	fragment@1 {
		target = <&spi0>;
		__overlay__ {
			/* needed to avoid dtc warning */
			#address-cells = <1>;
			#size-cells = <0>;
			status = "okay";

			st7735: st7735@0 {
				compatible = "fbtft,adafruit18";
				reg = <0>;
				pinctrl-names = "default";
				spi-max-frequency = <40000000>;
				rotate = <0>;
				buswidth = <8>;
				fps = <25>;
				height = <160>;
				width = <128>;
				reset-gpios = <&gpio 25 1>;
				dc-gpios = <&gpio 27 0>;
				led-gpios = <&gpio 18 0>;
				debug = <0>;
			};
		};
	};

	__overrides__ {
		green     = <&st7735>,"compatible=fbtft,adafruit18_green";
		height    = <&st7735>,"height:0";
		width     = <&st7735>,"width:0";
		speed     = <&st7735>,"spi-max-frequency:0";
		rotate    = <&st7735>,"rotate:0";
		fps       = <&st7735>,"fps:0";
		bgr       = <&st7735>,"bgr?";
		debug     = <&st7735>,"debug:0";
		dc_pin    = <&st7735>,"dc-gpios:4";
		reset_pin = <&st7735>,"reset-gpios:4";
		led_pin   = <&st7735>,"led-gpios:4";
	};
};
